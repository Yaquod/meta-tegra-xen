## conf/distro/tegra-xen.conf
```bitbake
require conf/distro/poky.conf

DISTRO = "tegra-xen"
DISTRO_NAME = "Tegra Xen Distro"
DISTRO_VERSION = "1.0"

INIT_MANAGER = "systemd"

DISTRO_FEATURES:append = " systemd usrmerge"
DISTRO_FEATURES:remove = "sysvinit"
DISTRO_FEATURES_BACKFILL_CONSIDERED:append = " sysvinit"

VIRTUAL-RUNTIME_init_manager = "systemd"
VIRTUAL-RUNTIME_initscripts = "systemd-compat-units"
VIRTUAL-RUNTIME_login_manager = "shadow-base"
VIRTUAL-RUNTIME_syslog = ""

PACKAGECONFIG:append:pn-systemd = " networkd"
```

## conf/layer.conf
```bitbake
# We have a conf and classes directory, add to BBPATH
BBPATH .= ":${LAYERDIR}"

# We have recipes-* directories, add to BBFILES
BBFILES += "${LAYERDIR}/recipes-*/*/*.bb \
            ${LAYERDIR}/recipes-*/*/*.bbappend"

BBFILE_COLLECTIONS += "meta-tegra-xen"
BBFILE_PATTERN_meta-tegra-xen = "^${LAYERDIR}/"
BBFILE_PRIORITY_meta-tegra-xen = "10"

LAYERDEPENDS_meta-tegra-xen = "core"
LAYERSERIES_COMPAT_meta-tegra-xen = "scarthgap"

LAYERDEPENDS_meta-tegra-xen = " \
    core \
    tegra \
    virtualization-layer \
"
```

## meta-xt-orin-domD/conf/layer.conf
```bitbake
BBPATH .= ":${LAYERDIR}"
BBFILES += "${LAYERDIR}/recipes-*/*/*.bb \
             ${LAYERDIR}/recipes-*/*/*.bbappend"
BBFILE_COLLECTIONS += "xt-orin-domd"
BBFILE_PATTERN_xt-orin-domd = "^${LAYERDIR}/"
BBFILE_PRIORITY_xt-orin-domd = "10"
LAYERSERIES_COMPAT_xt-orin-domd = "scarthgap"
```
